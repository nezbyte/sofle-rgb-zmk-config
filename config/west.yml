## config/west.yml
```yaml
manifest:
  remotes:
    - name: zmkfirmware
      url-base: https://github.com/maximus5684/zmk
  projects:
    - name: zmk
      remote: zmkfirmware
      revision: feature/sofle_rgb_keyhive
      import: app/west.yml
  self:
    path: config
```
